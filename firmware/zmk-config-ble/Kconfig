## firmware/zmk-config-ble/Kconfig
```kconfig
config KERF_DONGLE_STATUS_LED
    bool "kerf dongle RGB status LED (blue link / green caps / red battery)"
    default y if BOARD_KERF_DONGLE
    depends on ZMK_SPLIT_ROLE_CENTRAL && ZMK_HID_INDICATORS

if KERF_DONGLE_STATUS_LED

config KERF_DONGLE_LOW_BATTERY_PERCENT
    int "Keyboard battery level (%) at or below which the red LED flashes"
    default 15

endif
```

## firmware/zmk-config-ble/boards/arm/kerf_dongle/Kconfig.defconfig
```kconfig
if BOARD_KERF_DONGLE

config BOARD
    default "kerf_dongle"

config ZMK_KEYBOARD_NAME
    default "kerf dongle"

if USB_DEVICE_STACK

config USB_NRFX
    default y

endif # USB_DEVICE_STACK

config BT_CTLR
    default BT

config ZMK_USB
    default y

config ZMK_BLE
    default y

# The dongle is always USB powered: no battery measurement
config ZMK_BATTERY_REPORTING
    default n

endif # BOARD_KERF_DONGLE
```

## firmware/zmk-config-ble/dts/bindings/behaviors/kerf,behavior-batled.yaml
```yaml
description: Show the keyboard battery level on the LP63 indicator LED (LED9) for a few seconds.
compatible: "kerf,behavior-batled"
include: zero_param.yaml
```

## firmware/zmk-config-esb/Kconfig
```kconfig
config KERF_DONGLE_STATUS_LED
    bool "kerf dongle RGB status LED (blue link / green caps / red battery)"
    default y if BOARD_KERF_DONGLE
    depends on ZMK_SPLIT_ROLE_CENTRAL && ZMK_HID_INDICATORS

if KERF_DONGLE_STATUS_LED

config KERF_DONGLE_LOW_BATTERY_PERCENT
    int "Keyboard battery level (%) at or below which the red LED flashes"
    default 15

endif

config LP63_ESB_STATUS_SCREEN
    bool "nice!view status screen for the ESB link (replaces the BLE peripheral widget)"
    default y if ZMK_SPLIT_ESB && ZMK_DISPLAY && !ZMK_SPLIT_ROLE_CENTRAL
    select LV_FONT_MONTSERRAT_12
    select LV_FONT_MONTSERRAT_16
    select LV_USE_LABEL
```

## firmware/zmk-config-esb/boards/kerf/kerf_dongle/Kconfig.kerf_dongle
```kconfig
config BOARD_KERF_DONGLE
    select SOC_NRF52833_QDAA
    select ZMK_BOARD_COMPAT
    imply RETAINED_MEM
    imply RETENTION
    imply RETENTION_BOOT_MODE
```

## firmware/zmk-config-esb/boards/kerf/kerf_dongle/board.yml
```yaml
board:
  name: kerf_dongle
  full_name: kerf dongle (nRF52833 USB receiver)
  vendor: kerf
  socs:
    - name: nrf52833
```

## firmware/zmk-config-esb/dts/bindings/behaviors/kerf,behavior-rgb-esb.yaml
```yaml
description: |
  Underglow control that is sent to the keyboard the key came from.
  Needed on an ESB dongle: ESB centrals cannot broadcast BEHAVIOR_LOCALITY_GLOBAL
  behaviors such as &rgb_ug, so this forwards the same commands per event source.
compatible: "kerf,behavior-rgb-esb"
include: two_param.yaml
```

## firmware/zmk-config-esb/dts/bindings/led_strip/kerf,led-strip-split.yaml
```yaml
description: |
  Exposes the first chain-length pixels of a real LED strip as a separate strip
  (for ZMK underglow) and keeps the rest of the chain for status LEDs.
compatible: "kerf,led-strip-split"
properties:
  strip:
    type: phandle
    required: true
    description: the real LED strip (longer chain)
  chain-length:
    type: int
    required: true
    description: number of pixels shown to the user of this strip
```
